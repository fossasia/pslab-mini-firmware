## esp_firmware/main/Kconfig.projbuild
```kconfig
menu "PSLab ESP SPI bridge"

config ESP_BRIDGE_PROVISIONING_PASSWORD
    string "Temporary provisioning access point password"
    default "pslab-pico"
    help
        WPA2 password used by the temporary PSLab Pico setup access point.

config ESP_BRIDGE_DEST_IP
    string "Initial UDP destination IP"
    default "255.255.255.255"

config ESP_BRIDGE_DEST_PORT
    int "UDP destination port"
    default 5005

config ESP_BRIDGE_LOCAL_PORT
    int "SCPI TCP and registration UDP port"
    default 5006

config ESP_BRIDGE_PIN_SCLK
    int "SPI SCLK GPIO"
    default 4

config ESP_BRIDGE_PIN_MOSI
    int "SPI MOSI input GPIO"
    default 5

config ESP_BRIDGE_PIN_MISO
    int "SPI MISO output GPIO"
    default 6

config ESP_BRIDGE_PIN_CS
    int "SPI CS GPIO"
    default 7

config ESP_BRIDGE_PIN_READY
    int "READY output GPIO"
    default 10

config ESP_BRIDGE_REPORT_INTERVAL_MS
    int "Serial report interval in milliseconds"
    default 1000

endmenu
```

## esp_firmware/sdkconfig.defaults
```kconfig
CONFIG_IDF_TARGET="esp32c3"
CONFIG_ESPTOOLPY_FLASHSIZE_4MB=y
CONFIG_ESP_CONSOLE_USB_SERIAL_JTAG=y
CONFIG_LOG_DEFAULT_LEVEL_INFO=y

CONFIG_ESP_BRIDGE_PROVISIONING_PASSWORD="pslab-pico"
CONFIG_ESP_BRIDGE_DEST_IP="255.255.255.255"
CONFIG_ESP_BRIDGE_DEST_PORT=5005
CONFIG_ESP_BRIDGE_LOCAL_PORT=5006
CONFIG_ESP_BRIDGE_PIN_SCLK=4
CONFIG_ESP_BRIDGE_PIN_MOSI=5
CONFIG_ESP_BRIDGE_PIN_MISO=6
CONFIG_ESP_BRIDGE_PIN_CS=7
CONFIG_ESP_BRIDGE_PIN_READY=10
```
